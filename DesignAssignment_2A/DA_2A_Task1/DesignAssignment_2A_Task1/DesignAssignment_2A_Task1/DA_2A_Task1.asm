;
; DesignAssignment_2A_Task1.asm
; Assembly 
; Created: 9/26/2019 7:37:26 PM
; Author : BRYSEN KOKUBUN 
;


DUTY_CYCLE:
 
	SBI DDRB, 3					;DIRECTION PORTB.3 OUTPUT 
	SBI PORTB, 3				;SETTING PORTB.3 BIT "LED ON" 
	CALL DELAY_250ms			;CALL DELAY_250ms (.250s)
	CBI PORTB, 3				;CLEARING PORTB.3 BIT "LED OFF"
	CALL DELAY_375ms			;CALL DELAY_375ms (.375s)

RJMP DUTY_CYCLE

DELAY_250ms:			;DELAY OF .250s
    LDI R20, 8
D0: LDI R21, 200
D1: LDI R22, 249
	NOP
	NOP
D2: NOP
	NOP
	DEC R22
	BRNE D2
	DEC R21
	BRNE D1
	DEC R20
	BRNE D0
	RET

DELAY_375ms:			;DELAY OF .375s			
    LDI R20, 12
B0: LDI R21, 200
B1: LDI R22, 249
	NOP
	NOP
B2: NOP
	NOP
	DEC R22
	BRNE B2
	DEC R21
	BRNE B1
	DEC R20
	BRNE B0
	RET