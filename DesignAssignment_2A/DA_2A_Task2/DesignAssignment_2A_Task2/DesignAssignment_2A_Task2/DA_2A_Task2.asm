;
; DesignAssignment_2A_Task2.asm
; Assembly 
; Created: 9/26/2019 3:27:36 PM
; Author : BRYSEN KOKUBUN
;

SBI PORTC, 3					;SETS PORTC.3 TO ACTIVE HIGH
								;PULL UP RESISTOR ACTIVATED
	
DUTY_CYCLE:
	SBIS PINC, 3				;IF BUTTON @PORTC.3 PRESSED
	RJMP IF_BUTTON				;JUMP TO IF_BUTTON LABEL ELSE CONTINUE
 
	SBI DDRB, 3					;DIRECTION PORTB.3 OUTPUT 
	SBI PORTB, 3				;SETTING PORTB.3 BIT "LED ON" 
	CALL DELAY_250ms			;CALL DELAY_250ms (.250s)
	CBI PORTB, 3				;CLEARING PORTB.3 BIT "LED OFF"
	CALL DELAY_375ms			;CALL DELAY_375ms (.375s)

RJMP DUTY_CYCLE

IF_BUTTON:
	CBI DDRB, 3					;CLEARING DIRECTION PORTB.3 OUTPUT 
	CBI PORTB, 3				;CLEARING PORTB.3 BIT "LED OFF"
	SBI DDRB, 2 				;DIRECTION OF PORTB.2 OUTPUT "LED ON"	 
	CALL DELAY_BUTTON			;CALL DELAY OF 1.333s
	CBI DDRB, 2					;CLEARING DIRECTION PORTB.2 OUTPUT
	CBI PORTB, 2				;CLEARING PORTB.2 BIT "LED OFF"

	SBIS PINC, 3				;IF BUTTON @PORTC.3 PRESSED
	RJMP IF_BUTTON				;JUMP TO IF_BUTTON LABEL ELSE CONTINUE

RJMP DUTY_CYCLE


DELAY_250ms:			;DELAY OF .250s
    LDI R20, 8
D0: LDI R21, 200
D1: LDI R22, 249
	NOP
	NOP
D2: NOP
	NOP
	DEC R22
	BRNE D2
	DEC R21
	BRNE D1
	DEC R20
	BRNE D0
	RET

DELAY_375ms:			;DELAY OF .375s			
    LDI R20, 12
B0: LDI R21, 200
B1: LDI R22, 249
	NOP
	NOP
B2: NOP
	NOP
	DEC R22
	BRNE B2
	DEC R21
	BRNE B1
	DEC R20
	BRNE B0
	RET

DELAY_BUTTON:			;DELAY OF 1.333s
    LDI R20, 42
C0: LDI R21, 203
C1: LDI R22, 249
	NOP
	NOP
C2: NOP
	NOP
	DEC R22
	BRNE C2
	DEC R21
	BRNE C1
	DEC R20
	BRNE C0
	RET




