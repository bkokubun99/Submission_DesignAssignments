;
; DesignAssignment_1A.asm
;
; Created: 9/12/2019 10:38:53 PM
; Author : Brysen Kokubun 
;

	.ORG 0X0000
	
	START:
	;---------------LOADING REGISTERS-----------------------------------------;
		LDI R25, 0X11			;LOADS IMMEDIATELY THE VALUE OF 16 INTO THE
								;MULTIPLICAND'S UPPER PORTION OF 16 BITS
		LDI R24, 0X01			;LOADS IMMEDIATELY THE VALUE OF 1 INTO THE 
								;MULTIPLICAND'S LOWER PORTION OF 16 BITS
								;MULTIPLICAND = 4353
							
		LDI R23, 0X10			;LOADS IMMEDIATELY THE VALUE OF 1 INTO THE 
								;MULTIPLIER'S UPPER PORTION OF 16 BITS
		LDI R22, 0X01			;LOADS IMMEDIATELY THE VALUE OF 1 INTO THE 
								;MULTIPLIER'S LOWER PORTION OF 16 BITS
								;MULTIPLIER   = 4097
							
		LDI R20, 0X00			;INITIALIZE RESULT REGISTER R20 TO 0
		LDI R19, 0X00			;INITIALIZE RESULT REGISTER R19 TO 0
		LDI R18, 0X00 			;INITIALIZE RESULT REGISTER R18 TO 0
		LDI R17, 0X00			;INITIALIZE RESULT REGISTER R17 TO 0
		LDI R26, 0x00			;INITIALIZE REGISTER FOR NECESSARY CARRY 
		LDI R27, 0X00			;INITIALIZE REGISTER FOR NECESSARY CARRY 
	 
		CPI R22, 0				;COMPARES IF VALUE IN R22 == 0
		BREQ CHECK_REG			;IF R22 == 0 BRANCH TO CHECK_REG ELSE CONTINUE

	;---------------MULTIPLICATION BRANCH-------------------------------------;
		MULTIPLY:
			ADD  R17, R24		;ADDS LOWER 8 BITS OF MULTIPLICAND, 
								;STORES IN R17
			ADC  R18, R25		;ADDS UPPER 8 BITS OF MULTIPLICAND, 
								;STORES IN R18, CARRY IF NECESSARY
			ADC  R19, R26		;ADDS REGISTER INCASE THERE IS A CARRY 
			ADC  R20, R27		;ADDS REGISTER INCASE THERE IS A CARRY 

			DEC  R22			;DECREMENTS THE VALUE OF LOWER HALF OF MULTIPLIER 
			BRNE MULTIPLY       ;IF LOW HALF OF MULTIPLIER IS != 0 THEN BRANCH 
								;TO MULTIPLY ELSE CONTINUE
		CHECK_REG:
			CPI  R23, 0			;COMPARES IF VALUE IN R23 == 0
			BREQ DONE			;IF R23 == 0 BRANCH TO DONE ELSE CONTINUE

			DEC  R23 			;DECREMENT VALUE IN R23 
			COM  R22			;COMPLIMENT VALUE IN R22
			INC  R22			;INCREMENT R22

			JMP  MULTIPLY		;JUMP TO MULTIPLY LABEL 

	DONE: JMP DONE				;END OF PROGRAM