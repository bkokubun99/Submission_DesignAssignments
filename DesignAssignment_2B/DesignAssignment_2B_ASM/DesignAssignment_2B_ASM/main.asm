;
; DesignAssignment_2B_ASM.asm
; Assembly Program 
; Created: 10/5/2019 6:55:53 PM
; Author : BRYSEN KOKUBUN 
;

JMP DUTY_CYCLE 
.ORG 0X02						;LOCATION FOR EXTERNAL INTERRUPT 0
JMP EX0_ISR						;JUMP TO EXTERNAL INTERUPT LABEL

	LDI R20, HIGH(RAMEND)
	OUT SPH, R20
	LDI R20, LOW(RAMEND)
	OUT SPL, R20				;INITIALIZE STACK

DUTY_CYCLE:
	LDI R20, 0X2;				;MAKE INT0 INTO FALLING EDGE TRIGGERED 
	STS EICRA, R20				;EXTERNAL INTERUPT CONTROL REG 'A' NOW FALLING EDGE
	 
	SBI DDRB, 3					;DIRECTION PORTB.3 OUTPUT 
	SBI PORTB, 3				;SETTING PORTB.3 BIT "LED ON" 
	CALL DELAY_250ms			;CALL DELAY_250ms (.250s)
	CBI PORTB, 3				;CLEARING PORTB.3 BIT "LED OFF"
	CALL DELAY_375ms			;CALL DELAY_375ms (.375s)
	
	LDI R20, 1 << INT0			;ENABLE INTERRUPT 0 
	OUT EIMSK, R20				;MAKES MASK REGISTER ENABLED OUTPUT
	SEI;						;ENABLE GLOBAL INTERRUPT 

RJMP DUTY_CYCLE

EX0_ISR:
	CBI DDRB, 3					;CLEARING DIRECTION PORTB.3 OUTPUT 
	SBI DDRB, 2 				;DIRECTION OF PORTB.2 OUTPUT "LED ON"	
	CALL DELAY_BUTTON			;CALL DELAY OF 1.333s
	CBI DDRB, 2					;CLEARING DIRECTION PORTB.2 OUTPUT
	RETI


DELAY_250ms:			;DELAY OF .250s
    LDI R20, 8
D0: LDI R21, 200
D1: LDI R22, 249
	NOP
	NOP
D2: NOP
	NOP
	DEC R22
	BRNE D2
	DEC R21
	BRNE D1
	DEC R20
	BRNE D0
	RET

DELAY_375ms:			;DELAY OF .375s			
    LDI R20, 12
B0: LDI R21, 200
B1: LDI R22, 249
	NOP
	NOP
B2: NOP
	NOP
	DEC R22
	BRNE B2
	DEC R21
	BRNE B1
	DEC R20
	BRNE B0
	RET

DELAY_BUTTON:			;DELAY OF 1.333s
    LDI R20, 42
C0: LDI R21, 203
C1: LDI R22, 249
	NOP
	NOP
C2: NOP
	NOP
	DEC R22
	BRNE C2
	DEC R21
	BRNE C1
	DEC R20
	BRNE C0
	RET